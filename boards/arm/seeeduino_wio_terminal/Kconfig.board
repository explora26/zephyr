## boards/arm/seeeduino_wio_terminal/Kconfig.board
```kconfig
# Seeeduino Wio Terminal configuration

# Copyright (c) 2021 Harry Jiang
# SPDX-License-Identifier: Apache-2.0

config BOARD_SEEEDUINO_WIO_TERMINAL
	bool "Seeeduino Wio Terminal"
	depends on SOC_PART_NUMBER_SAMD51P19A
```

## boards/arm/seeeduino_wio_terminal/Kconfig.defconfig
```kconfig
# Seeeduino Wio Terminal configuration

# Copyright (c) 2021 Harry Jiang
# SPDX-License-Identifier: Apache-2.0

config BOARD
	default "seeeduino_wio_terminal"
	depends on BOARD_SEEEDUINO_WIO_TERMINAL
```

## boards/boltun/sto_c03/Kconfig.sto_c03
```kconfig
# SPDX-License-Identifier: Apache-2.0

config BOARD_STO_C03
	select SOC_STM32H750XX
```

## boards/boltun/sto_c03/Kconfig.sysbuild
```kconfig
# SPDX-License-Identifier: Apache-2.0

if BOARD_STO_C03_STM32H750XX_EXT_FLASH_APP

choice BOOTLOADER
	default BOOTLOADER_MCUBOOT
endchoice

choice BOOT_SIGNATURE_TYPE
	default BOOT_SIGNATURE_TYPE_NONE
endchoice

endif # BOARD_STO_C03_STM32H750XX_EXT_FLASH_APP
```

## boards/boltun/sto_c03/board.yml
```yaml
board:
  name: sto_c03
  full_name: Boltun STO-C03
  vendor: boltun
  socs:
    - name: stm32h750xx
      variants:
        - name: ext_flash_app
```

## boards/m5stack/m5stack_atoms3r/Kconfig.defconfig
```kconfig
# M5Stack AtomS3R board configuration
# Copyright (c) 2024 M5Stack
# SPDX-License-Identifier: Apache-2.0

if BOARD_M5STACK_ATOMS3R_ESP32S3_PROCPU

configdefault LV_COLOR_16_SWAP
	default y if LVGL

endif # BOARD_M5STACK_ATOMS3R_ESP32S3_PROCPU
```

## boards/m5stack/m5stack_atoms3r/Kconfig.m5stack_atoms3r
```kconfig
# M5Stack AtomS3R board configuration

# Copyright (c) 2024 M5Stack
# SPDX-License-Identifier: Apache-2.0

config BOARD_M5STACK_ATOMS3R
	select SOC_ESP32S3_PICO_N8R8
	select SOC_ESP32S3_PROCPU if BOARD_M5STACK_ATOMS3R_ESP32S3_PROCPU
	select SOC_ESP32S3_APPCPU if BOARD_M5STACK_ATOMS3R_ESP32S3_APPCPU
```

## boards/m5stack/m5stack_atoms3r/board.yml
```yaml
board:
  name: m5stack_atoms3r
  full_name: AtomS3R
  vendor: m5stack
  socs:
  - name: esp32s3
```

## boards/m5stack/m5stack_dinmeter/Kconfig
```kconfig
# Copyright (c) 2024 TOKITA Hiroshi
# SPDX-License-Identifier: Apache-2.0

config HEAP_MEM_POOL_ADD_SIZE_BOARD
	int
	default 4096 if BOARD_M5STACK_DINMETER_ESP32S3_PROCPU
	default 256 if BOARD_M5STACK_DINMETER_ESP32S3_APPCPU
```

## boards/m5stack/m5stack_dinmeter/Kconfig.defconfig
```kconfig
# M5Stack DinMeter board configuration
# Copyright (c) 2024 TOKITA Hiroshi
# SPDX-License-Identifier: Apache-2.0

if BOARD_M5STACK_DINMETER_ESP32S3_PROCPU

config KERNEL_MEM_POOL
	default y

if LVGL

choice LV_COLOR_DEPTH
	default LV_COLOR_DEPTH_16
endchoice

config LV_COLOR_16_SWAP
	default y

endif # LVGL

endif # BOARD_M5STACK_DINMETER_ESP32S3_PROCPU
```

## boards/m5stack/m5stack_dinmeter/Kconfig.m5stack_dinmeter
```kconfig
# M5Stack DinMeter board configuration
# Copyright (c) 2024 TOKITA Hiroshi
# SPDX-License-Identifier: Apache-2.0

config BOARD_M5STACK_DINMETER
	select SOC_ESP32S3_FN8
	select SOC_ESP32S3_PROCPU if BOARD_M5STACK_DINMETER_ESP32S3_PROCPU
	select SOC_ESP32S3_APPCPU if BOARD_M5STACK_DINMETER_ESP32S3_APPCPU
```

## boards/m5stack/m5stack_dinmeter/board.yml
```yaml
board:
  name: m5stack_dinmeter
  full_name: M5Stack DinMeter
  vendor: m5stack
  socs:
  - name: esp32s3
```

## boards/m5stack/m5stack_dinmeter/m5stack_dinmeter_procpu_defconfig
```kconfig
# SPDX-License-Identifier: Apache-2.0

CONFIG_GPIO=y

CONFIG_CONSOLE=y
CONFIG_PWM=y
CONFIG_SERIAL=y
CONFIG_UART_CONSOLE=y
CONFIG_CLOCK_CONTROL=y

CONFIG_I2C=y
CONFIG_SPI=y
CONFIG_SENSOR=y
CONFIG_REGULATOR=y
```

## boards/m5stack/m5stack_tab5/Kconfig
```kconfig
# SPDX-FileCopyrightText: Copyright The Zephyr Project Contributors
# SPDX-License-Identifier: Apache-2.0

config HEAP_MEM_POOL_ADD_SIZE_BOARD
	int
	default 4096 if BOARD_M5STACK_TAB5_ESP32P4_HPCORE
```

## boards/m5stack/m5stack_tab5/Kconfig.m5stack_tab5
```kconfig
# SPDX-FileCopyrightText: Copyright The Zephyr Project Contributors
# SPDX-License-Identifier: Apache-2.0

config BOARD_M5STACK_TAB5
	select SOC_ESP32P4_HPCORE if BOARD_M5STACK_TAB5_ESP32P4_HPCORE
	select SOC_ESP32P4_REV_1_3
```

## boards/m5stack/m5stack_tab5/board.yml
```yaml
board:
  name: m5stack_tab5
  full_name: Tab5
  vendor: m5stack
  revision:
    format: number
    default: "3"
    revisions:
      - name: "1"
      - name: "2"
      - name: "3"
  socs:
    - name: esp32p4
```

## boards/waveshare/esp32s3_touch_lcd_2_8/Kconfig.esp32s3_touch_lcd_2_8
```kconfig
# Copyright (c) 2025 Harry Jiang
# SPDX-License-Identifier: Apache-2.0

config BOARD_ESP32S3_TOUCH_LCD_2_8
	select SOC_ESP32S3_R8
	select SOC_ESP32S3_PROCPU if BOARD_ESP32S3_TOUCH_LCD_2_8_ESP32S3_PROCPU
	select SOC_ESP32S3_APPCPU if BOARD_ESP32S3_TOUCH_LCD_2_8_ESP32S3_APPCPU 
```

## boards/waveshare/esp32s3_touch_lcd_2_8/Kconfig.sysbuild
```kconfig
# Copyright (c) 2025 Harry Jiang
# SPDX-License-Identifier: Apache-2.0

choice BOOTLOADER
	default BOOTLOADER_MCUBOOT
endchoice

choice BOOT_SIGNATURE_TYPE
	default BOOT_SIGNATURE_TYPE_NONE
endchoice 
```

## boards/weact/mini_stm32h743/Kconfig.sysbuild
```kconfig
# SPDX-FileCopyrightText: Copyright The Zephyr Project Contributors
# SPDX-License-Identifier: Apache-2.0

if BOARD_MINI_STM32H743_STM32H743XX_EXT_FLASH_APP

choice BOOTLOADER
	default BOOTLOADER_MCUBOOT
endchoice

choice BOOT_SIGNATURE_TYPE
	default BOOT_SIGNATURE_TYPE_NONE
endchoice

choice MCUBOOT_MODE
	default MCUBOOT_MODE_SWAP_USING_OFFSET
endchoice

endif # BOARD_MINI_STM32H743_STM32H743XX_EXT_FLASH_APP
```

## boards/weact/mini_stm32h750/Kconfig.defconfig
```kconfig
# WeAct Studio MiniSTM32H750 board configuration

# SPDX-FileCopyrightText: Copyright The Zephyr Project Contributors
# SPDX-License-Identifier: Apache-2.0

if BOARD_MINI_STM32H750

if DISPLAY

config INPUT
	default y

if LVGL

configdefault LV_COLOR_16_SWAP
	default y

config LV_Z_BITS_PER_PIXEL
	default 16

endif # LVGL

endif # DISPLAY

endif # BOARD_MINI_STM32H750
```

## boards/weact/mini_stm32h750/Kconfig.mini_stm32h750
```kconfig
# Copyright (c) 2024 WeAct Studio
# SPDX-License-Identifier: Apache-2.0

config BOARD_MINI_STM32H750
	select SOC_STM32H750XX
```

## drivers/display/Kconfig.esp32_lcd_cam_rgb
```kconfig
# SPDX-FileCopyrightText: Copyright The Zephyr Project Contributors
# SPDX-License-Identifier: Apache-2.0

menuconfig DISPLAY_ESP32_LCD_CAM_RGB
	bool "ESP32 LCD-CAM RGB display controller"
	default y
	depends on DT_HAS_ESPRESSIF_ESP32_LCD_CAM_RGB_ENABLED
	select DMA
	select ESP_SPIRAM
	select SHARED_MULTI_HEAP
	help
	  Enable driver for the RGB (DPI) interface of the ESP32 LCD-CAM
	  peripheral, which streams a framebuffer to the panel. The
	  framebuffers are allocated from PSRAM.

if DISPLAY_ESP32_LCD_CAM_RGB

config DISPLAY_ESP32_LCD_CAM_RGB_FB_NUM
	int "Number of framebuffers"
	default 1
	range 1 2
	help
	  With two framebuffers a frame is drawn while the other one is on
	  screen and they are swapped at a frame start, so an update does not
	  tear. A partial update then copies the whole frame on screen into
	  the buffer being drawn first.

endif # DISPLAY_ESP32_LCD_CAM_RGB
```
