## boards/arm/ministm32h743/Kconfig.board
```kconfig
# STM32H743ZI Nucleo board configuration

# Copyright (c) 2020 Teslabs Engineering S.L.
# SPDX-License-Identifier: Apache-2.0

config BOARD_MINISTM32H743
	bool "WeAct Mini STM32H743 Development Board"
	depends on SOC_STM32H743XX
```

## boards/arm/ministm32h743/ministm32h743_defconfig
```kconfig
# SPDX-License-Identifier: Apache-2.0

CONFIG_SOC_SERIES_STM32H7X=y
CONFIG_SOC_STM32H743XX=y
# 96MHz system clock (CubeMX Defaults)
CONFIG_SYS_CLOCK_HW_CYCLES_PER_SEC=400000000

# Enable MPU
CONFIG_ARM_MPU=y

# Enable UART
CONFIG_SERIAL=y

# Console
CONFIG_CONSOLE=y
CONFIG_UART_CONSOLE=y

# Enable Pinmux
CONFIG_PINMUX=y

# Enable GPIO
CONFIG_GPIO=y

# Clock Configuration
CONFIG_CLOCK_CONTROL=y

# STLINK provides 8MHz clock input
CONFIG_CLOCK_STM32_HSE_CLOCK=25000000
CONFIG_CLOCK_STM32_SYSCLK_SRC_PLL=y
# Use HSE as PLL input
CONFIG_CLOCK_STM32_PLL_SRC_HSE=y
# Nucleo-144 boards do not have an external oscillator, so just use
# the 8MHz clock signal coming from integrated STLink

# Produce 96MHz clock at PLL output
CONFIG_CLOCK_STM32_PLL_M_DIVISOR=5
CONFIG_CLOCK_STM32_PLL_N_MULTIPLIER=160
CONFIG_CLOCK_STM32_PLL_P_DIVISOR=2
CONFIG_CLOCK_STM32_PLL_Q_DIVISOR=4
CONFIG_CLOCK_STM32_PLL_R_DIVISOR=2
```

## boards/arm/nucleo_h743zi/Kconfig.defconfig
```kconfig
# STM32H743ZI Nucleo board configuration

# Copyright (c) 2020 Teslabs Engineering S.L.
# SPDX-License-Identifier: Apache-2.0

if BOARD_NUCLEO_H743ZI

config BOARD
	default "nucleo_h743zi"

config CLOCK_STM32_D1CPRE
	default 1

config CLOCK_STM32_HPRE
	# HCLK: 200MHz
	default 2

config CLOCK_STM32_D2PPRE1
	# APBX: 100MHz
	default 2

config CLOCK_STM32_D2PPRE2
	default 2

config CLOCK_STM32_D1PPRE
	default 2

config CLOCK_STM32_D3PPRE
	default 2

endif # BOARD_NUCLEO_H743ZI
```

## drivers/display/Kconfig.ili9486
```kconfig
# Kconfig - ILI9486 display driver configuration options

#
# Copyright (c) 2019 Harry Jiang
#
# SPDX-License-Identifier: Apache-2.0
#

menuconfig ILI9486
	bool "ILI9486 display driver"
	depends on SPI
	help
	Enable driver for ILI9486 display driver.

if ILI9486

choice
	prompt "LCD"
	default ILI9486_LCD_WAVESHARE_40C
	help
	Specify the type of LCD connected to the ILI9486 display controller.

config ILI9486_LCD_WAVESHARE_35B_V2
	bool "Waveshare 3.5\" TFT Rev.B v2.0"

config ILI9486_LCD_WAVESHARE_40C
	bool "Waveshare 4\" TFT Rev.C"

endchoice

choice
	prompt "Color pixel format"
	help
	Specify the color pixel format of the ILI9486 display controller.

config ILI9486_RGB888
	bool "RGB888"

config ILI9486_RGB565
	bool "RGB565"

endchoice

endif #ILI9486
```

## drivers/kscan/Kconfig.xpt2046
```kconfig
# Copyright (c) 2020 Harry Jiang <explora26@gmail.com>
# SPDX-License-Identifier: Apache-2.0

menuconfig KSCAN_XPT2046
	bool "XPT2046 touch panel driver"
	depends on SPI
	help
	  Enable driver for XPT2046 touch panel controllers.

if KSCAN_XPT2046

config KSCAN_XPT2046_PERIOD
	int "Sample period"
	depends on !KSCAN_XPT2046_INTERRUPT
	default 10
	help
	  Sample period in milliseconds when in polling mode.

config KSCAN_XPT2046_INTERRUPT
	bool "Enable interrupt"
	help
	  Enable interrupt support (requires GPIO).

endif # KSCAN_XPT2046
```

## dts/bindings/display/ilitek,ili9486.yaml
```yaml
#
# Copyright (c) 2019, Harry Jiang
#
# SPDX-License-Identifier: Apache-2.0
#

description: ILI9486 480x320 Display Controller

compatible: "ilitek,ili9486"

include: spi-device.yaml

properties:
    reset-gpios:
      type: phandle-array
      required: false
      description: RESET pin.

        The RESET pin of ILI9340 is active low.
        If connected directly the MCU pin should be configured
        as active low.

    cmd-data-gpios:
      type: phandle-array
      required: true
      description: D/CX pin.
```

## dts/bindings/flash_controller/st,stm32h7-flash-controller.yaml
```yaml
description: STM32 H7 flash controller

compatible: "st,stm32H7-flash-controller"

include: flash-controller.yaml
```

## dts/bindings/kscan/xptek,xpt2046.yaml
```yaml
# Copyright (c) 2020 Harry Jiang <explora26@gmail.com>
# SPDX-License-Identifier: Apache-2.0

description: XPTEK XPT2046 touch panels

compatible: "xptek,xpt2046"

include: [kscan.yaml, spi-device.yaml]

properties:
    int-gpios:
      type: phandle-array
      required: false
```
