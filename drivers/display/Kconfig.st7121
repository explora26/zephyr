## drivers/display/Kconfig.st7121
```kconfig
# SPDX-FileCopyrightText: Copyright The Zephyr Project Contributors
# SPDX-License-Identifier: Apache-2.0

config ST7121
	bool "Sitronix ST7121 and ST7123 MIPI DSI display driver"
	default y
	depends on DT_HAS_SITRONIX_ST7121_ENABLED || DT_HAS_SITRONIX_ST7123_ENABLED
	select MIPI_DSI
	select GPIO if $(dt_compat_any_has_prop,$(DT_COMPAT_SITRONIX_ST7121),reset-gpios) || \
		$(dt_compat_any_has_prop,$(DT_COMPAT_SITRONIX_ST7121),bl-gpios) || \
		$(dt_compat_any_has_prop,$(DT_COMPAT_SITRONIX_ST7123),reset-gpios) || \
		$(dt_compat_any_has_prop,$(DT_COMPAT_SITRONIX_ST7123),bl-gpios)
	help
	  Enable driver for the Sitronix ST7121 and ST7123 MIPI DSI display
	  controllers.

config ST7121_INIT_PRIORITY
	int "ST7121 and ST7123 initialization priority"
	depends on ST7121
	default MIPI_DSI_INIT_PRIORITY
	help
	  Display driver initialization priority. The panel attaches to the
	  MIPI DSI host, so it has to initialize after the host and after the
	  controller streaming to it.
```

## drivers/display/Kconfig.st7701
```kconfig
# Copyright (c) 2025 Arduino SA
# SPDX-License-Identifier: Apache-2.0

config ST7701
	bool "ST7701 display controller driver"
	default y
	depends on DT_HAS_SITRONIX_ST7701_ENABLED
	select MIPI_DSI if $(dt_compat_on_bus,$(DT_COMPAT_SITRONIX_ST7701),mipi-dsi)
	select MIPI_DBI if $(dt_compat_on_bus,$(DT_COMPAT_SITRONIX_ST7701),mipi-dbi)
	help
	  Enable driver for ST7701 display driver, configured over MIPI DSI or
	  over a MIPI DBI (serial) interface.
```

## drivers/input/Kconfig.st7123
```kconfig
# SPDX-FileCopyrightText: Copyright The Zephyr Project Contributors
# SPDX-License-Identifier: Apache-2.0

menuconfig INPUT_ST7123
	bool "Sitronix ST7123 touch controller driver"
	default y
	depends on DT_HAS_SITRONIX_ST7123_TOUCH_ENABLED
	select I2C
	select INPUT_TOUCH
	help
	  Enable driver for the touch controller integrated in the Sitronix
	  ST7121 and ST7123 TDDI display drivers.

if INPUT_ST7123

config INPUT_ST7123_INTERRUPT
	bool "Interrupt"
	default y if $(dt_compat_any_has_prop,$(DT_COMPAT_SITRONIX_ST7123_TOUCH),int-gpios)
	select GPIO
	help
	  Read touch data when the controller asserts its interrupt line
	  instead of polling it.

config INPUT_ST7123_PERIOD_MS
	int "Sample period"
	depends on !INPUT_ST7123_INTERRUPT
	default 20
	help
	  Sample period in milliseconds when in polling mode.

endif # INPUT_ST7123
```

## dts/bindings/display/espressif,esp32-lcd-cam-rgb.yaml
```yaml
# SPDX-FileCopyrightText: Copyright The Zephyr Project Contributors
# SPDX-License-Identifier: Apache-2.0

description: |
  ESP32 LCD-CAM RGB (DPI) display controller

  Streams a framebuffer held in PSRAM to a panel over a 16-bit parallel RGB
  interface with HSYNC, VSYNC, DE and PCLK signals. The pins are configured
  through the pinctrl of the parent LCD-CAM node, and the panel timing is
  described by a zephyr,panel-timing child node named display-timings.

  Only the RGB565 pixel format is supported. Panels that need a register
  setup, such as the Sitronix ST7701, are described separately on their
  serial configuration bus.

  Example:

    &lcd_cam_rgb {
      status = "okay";
      width = <480>;
      height = <640>;
      pixel-format = <PANEL_PIXEL_FORMAT_RGB_565>;

      display-timings {
        compatible = "zephyr,panel-timing";
        clock-frequency = <16000000>;
        hsync-len = <10>;
        hback-porch = <70>;
        hfront-porch = <60>;
        vsync-len = <10>;
        vback-porch = <20>;
        vfront-porch = <20>;
        hsync-active = <0>;
        vsync-active = <0>;
        de-active = <1>;
        pixelclk-active = <1>;
      };
    };

compatible: "espressif,esp32-lcd-cam-rgb"

include: lcd-controller.yaml
```

## dts/bindings/display/ilitek,ili9881c.yaml
```yaml
# SPDX-FileCopyrightText: 2026 Renesas Electronics Corporation
# SPDX-License-Identifier: Apache-2.0

description: |
   The Ilitek ILI9881C is a 16.7M colors TFT-LCD controller
   with a maximum 720RGBx1280 resolution.

compatible: "ilitek,ili9881c"

include: [mipi-dsi-device.yaml, display-controller.yaml]

properties:
  reset-gpios:
    type: phandle-array
    description: |
      The RESETn pin is asserted to disable the sensor causing a hard
      reset. The sensor receives this as an active-low signal.

  bl-gpios:
    type: phandle-array
    description: |
      The BLn pin is asserted to control the backlight of the panel.
      The sensor receives this as an active-high signal.

  init-sequence:
    type: string
    default: "rtkapplcdms02001be"
    enum:
      - "rtkapplcdms02001be"
      - "m5stack-tab5"
    description: |
      Manufacturer settings written to the controller at initialization.
      They come from the panel vendor and differ between panels.

      - rtkapplcdms02001be: Rocktech RK055 panel of the Renesas
        RTKAPPLCDMS02001BE display, driven over four data lanes
      - m5stack-tab5: 5-inch 720x1280 panel of the M5Stack Tab5 (board
        revision 1), driven over two data lanes
```

## dts/bindings/display/sitronix,st7123.yaml
```yaml
# SPDX-FileCopyrightText: Copyright The Zephyr Project Contributors
# SPDX-License-Identifier: Apache-2.0

title: Sitronix ST7123 MIPI DSI display controller

description: |
  Sitronix ST7123 TFT-LCD driver with integrated touch controller, driving
  a 720x1280 panel over a two-lane MIPI DSI link in video mode.

  The driver programs the initialization sequence of the 5-inch 720x1280
  panel used on the M5Stack Tab5.

compatible: "sitronix,st7123"

include: [mipi-dsi-device.yaml, display-controller.yaml]

properties:
  reset-gpios:
    type: phandle-array
    description: |
      Reset GPIO (active low). Without it the controller is reset with the
      DCS soft reset command.

  bl-gpios:
    type: phandle-array
    description: |
      Backlight enable GPIO (active high).
```

## dts/bindings/display/sitronix,st7701-mipi-dbi.yaml
```yaml
# SPDX-FileCopyrightText: Copyright The Zephyr Project Contributors
# SPDX-License-Identifier: Apache-2.0

title: Sitronix ST7701 display controller on MIPI DBI bus

description: |
    The Sitronix ST7701 is a 16.7M colors TFT-LCD controller
    with a maximum 480RGBx864 resolution.

    On the MIPI DBI bus the controller is only configured through its
    serial interface, typically 3-wire SPI with 9-bit words. The pixel
    data is streamed through the controller's RGB (DPI) interface by a
    separate display controller, which is the display device to use.

compatible: "sitronix,st7701"

include: ["mipi-dbi-spi-device.yaml", "sitronix,st7701-common.yaml"]

properties:
  pixel-format:
    type: int
    default: 16
    description: |
      Pixel format of the RGB interface. The default is RGB565.
    enum:
      - 1 # PANEL_PIXEL_FORMAT_RGB_888
      - 16 # PANEL_PIXEL_FORMAT_RGB_565
```

## dts/bindings/input/sitronix,st7123-touch.yaml
```yaml
# SPDX-FileCopyrightText: Copyright The Zephyr Project Contributors
# SPDX-License-Identifier: Apache-2.0

title: Sitronix ST7123 touch controller

description: |
  Touch controller integrated in the Sitronix ST7121 and ST7123 TDDI display
  drivers. It is accessed over I2C with 16-bit register addresses.

compatible: "sitronix,st7123-touch"

include: [i2c-device.yaml, touchscreen-common.yaml]

properties:
  int-gpios:
    type: phandle-array
    description: |
      Interrupt GPIO. The controller drives it to signal that touch data is
      available. Active low. Without it the controller is polled.

  reset-gpios:
    type: phandle-array
    description: |
      Reset GPIO (active low).
```
